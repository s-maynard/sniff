## meta-wifi-sniffer/conf/layer.conf
```bitbake
BBPATH .= ":${LAYERDIR}"

BBFILES += "\
            ${LAYERDIR}/recipes-*/*/*.bb \
            ${LAYERDIR}/recipes-*/*/*.bbappend \
           "

BBFILE_COLLECTIONS += "cpe-raspi"
BBFILE_PATTERN_cpe-raspi := "^${LAYERDIR}/"
BBFILE_PRIORITY_cpe-raspi = "7"

# Additional license directories.
LICENSE_PATH += "${LAYERDIR}/licenses"
```
